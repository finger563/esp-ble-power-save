## main/Kconfig.projbuild
```kconfig
menu "Example Configuration"

    choice EXAMPLE_MAX_CPU_FREQ
        prompt "Maximum CPU frequency"
        default EXAMPLE_MAX_CPU_FREQ_160
        depends on PM_ENABLE
        help
            Maximum CPU frequency to use for dynamic frequency scaling.

        config EXAMPLE_MAX_CPU_FREQ_80
            bool "80 MHz"
        config EXAMPLE_MAX_CPU_FREQ_160
            bool "160 MHz"
        config EXAMPLE_MAX_CPU_FREQ_240
            depends on IDF_TARGET_ESP32 || IDF_TARGET_ESP32S3
            bool "240 MHz"
    endchoice

    config EXAMPLE_MAX_CPU_FREQ_MHZ
        int
        default 80 if EXAMPLE_MAX_CPU_FREQ_80
        default 160 if EXAMPLE_MAX_CPU_FREQ_160
        default 240 if EXAMPLE_MAX_CPU_FREQ_240


    choice EXAMPLE_MIN_CPU_FREQ
        prompt "Minimum CPU frequency"
        default EXAMPLE_MIN_CPU_FREQ_40M
        depends on PM_ENABLE
        help
            Minimum CPU frequency to use for dynamic frequency scaling.
            Should be set to XTAL frequency or XTAL frequency divided by integer.

        config EXAMPLE_MIN_CPU_FREQ_80M
            bool "80 MHz"
        config EXAMPLE_MIN_CPU_FREQ_40M
            bool "40 MHz"
    endchoice

    config EXAMPLE_MIN_CPU_FREQ_MHZ
        int
        default 80 if EXAMPLE_MIN_CPU_FREQ_80M
        default 40 if EXAMPLE_MIN_CPU_FREQ_40M

    config EXAMPLE_SET_RAW_ADV_DATA
        bool "Use raw data for advertising packets and scan response data"
        help
            If this config item is set, raw binary data will be used to generate advertising & scan response data.
            This option uses the esp_ble_gap_config_adv_data_raw() and esp_ble_gap_config_scan_rsp_data_raw()
            functions.

            If this config item is unset, advertising & scan response data is provided via a higher-level
            esp_ble_adv_data_t structure. The lower layer will generate the BLE packets. This option has higher
            overhead at runtime.

endmenu
```

## sdkconfig.defaults.esp32_32k
```kconfig
# Override some defaults so BT stack is enabled
# by default in this example
CONFIG_BT_ENABLED=y
CONFIG_BTDM_CTRL_MODE_BLE_ONLY=y
CONFIG_BTDM_CTRL_MODE_BR_EDR_ONLY=n
CONFIG_BTDM_CTRL_MODE_BTDM=n

# MODEM SLEEP Options
CONFIG_BTDM_CTRL_MODEM_SLEEP=y
CONFIG_BTDM_CTRL_MODEM_SLEEP_MODE_ORIG=y
# Bluetooth low power clock
CONFIG_BTDM_CTRL_LPCLK_SEL_EXT_32K_XTAL=y

# RTC clock source
CONFIG_ESP32_RTC_CLK_SRC_EXT_CRYS=y

# Enable support for power management
CONFIG_PM_ENABLE=y
# Enable tickless idle mode
CONFIG_FREERTOS_USE_TICKLESS_IDLE=y
# Set the tick rate at which FreeRTOS does pre-emptive context switching.
CONFIG_FREERTOS_HZ=1000
# Minimum number of ticks to enter sleep mode for
CONFIG_FREERTOS_IDLE_TIME_BEFORE_SLEEP=3
```

## sdkconfig.defaults.esp32s3_40m
```kconfig
# Override some defaults so BT stack is enabled
# by default in this example
CONFIG_BT_ENABLED=y
CONFIG_BT_BLE_ENABLED=y
CONFIG_BT_GATTS_ENABLE=y
CONFIG_BT_BLE_42_FEATURES_SUPPORTED=y

# MODEM SLEEP Options
CONFIG_BT_CTRL_MODEM_SLEEP=y
CONFIG_BT_CTRL_MODEM_SLEEP_MODE_1=y
# Bluetooth low power clock
CONFIG_BT_CTRL_LPCLK_SEL_MAIN_XTAL=y

# RTC clock source
CONFIG_ESP32S3_RTC_CLK_SRC_INT_RC=y

# Enable support for power management
CONFIG_PM_ENABLE=y
# Enable tickless idle mode
CONFIG_FREERTOS_USE_TICKLESS_IDLE=y
# Set the tick rate at which FreeRTOS does pre-emptive context switching.
CONFIG_FREERTOS_HZ=1000
# Minimum number of ticks to enter sleep mode for
CONFIG_FREERTOS_IDLE_TIME_BEFORE_SLEEP=3
```
